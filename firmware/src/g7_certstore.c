#include "g7_certstore.h"

#include <errno.h>
#include <string.h>

#include <zephyr/kernel.h>
#include <zephyr/logging/log.h>
#include <zephyr/random/random.h>
#include <zephyr/settings/settings.h>

#include <tinycrypt/ecc.h>
#include <tinycrypt/ecc_dsa.h>
#include <tinycrypt/sha256.h>

#if __has_include("g7_certs.h")
/* Private builds only: generated by tools/make_g7_certs.py. */
#include "g7_certs.h"
#define HAVE_BUILTIN 1
#else
#define HAVE_BUILTIN 0
#endif

LOG_MODULE_REGISTER(g7_certstore, LOG_LEVEL_INF);

#define KEY_LEN 32
/* libkeks rejects shorter certificates. */
#define CERT_MIN_LEN 101

static struct {
	uint8_t a[G7_CERT_MAX_LEN];
	uint8_t b[G7_CERT_MAX_LEN];
	uint8_t key[KEY_LEN];
	size_t a_len, b_len;
	bool valid;
} stored;

/* Upload in progress; parts may arrive in any order. */
static struct {
	uint8_t a[G7_CERT_MAX_LEN];
	uint8_t b[G7_CERT_MAX_LEN];
	uint8_t key[G7_CERT_KEY_MAX_LEN];
	size_t a_len, b_len, key_len;
} staged;

static K_MUTEX_DEFINE(lock);

/* TinyCrypt's ecc.c defaults its RNG to this, but Zephyr does not build the
 * platform file that normally provides it. uECC_sign() needs it for its nonce.
 */
int default_CSPRNG(uint8_t *dest, unsigned int size)
{
	return sys_csrand_get(dest, size) == 0;
}

/* ---- settings ----------------------------------------------------------------- */

static int load_part(uint8_t *dst, size_t max, size_t *out_len, size_t len,
		     settings_read_cb read_cb, void *cb_arg)
{
	if (len > max) {
		return -EINVAL;
	}

	ssize_t rc = read_cb(cb_arg, dst, len);

	if (rc < 0) {
		return rc;
	}
	*out_len = rc;
	return 0;
}

static size_t loaded_key_len;

static int g7cert_set(const char *name, size_t len, settings_read_cb read_cb, void *cb_arg)
{
	const char *next;

	if (settings_name_steq(name, "a", &next) && !next) {
		return load_part(stored.a, sizeof(stored.a), &stored.a_len, len, read_cb, cb_arg);
	}
	if (settings_name_steq(name, "b", &next) && !next) {
		return load_part(stored.b, sizeof(stored.b), &stored.b_len, len, read_cb, cb_arg);
	}
	if (settings_name_steq(name, "k", &next) && !next) {
		return load_part(stored.key, sizeof(stored.key), &loaded_key_len, len, read_cb,
				 cb_arg);
	}
	return -ENOENT;
}

static int g7cert_commit_loaded(void)
{
	stored.valid = stored.a_len >= CERT_MIN_LEN && stored.b_len >= CERT_MIN_LEN &&
		       loaded_key_len == KEY_LEN;
	return 0;
}

SETTINGS_STATIC_HANDLER_DEFINE(g7cert, "g7cert", NULL, g7cert_set, g7cert_commit_loaded, NULL);

/* ---- access ------------------------------------------------------------------- */

enum g7_cert_source g7_certs_source(void)
{
	if (stored.valid) {
		return G7_CERTS_STORED;
	}
	return HAVE_BUILTIN ? G7_CERTS_BUILTIN : G7_CERTS_NONE;
}

const uint8_t *g7_certs_a(size_t *len)
{
#if HAVE_BUILTIN
	if (!stored.valid) {
		*len = sizeof(g7_cert_a);
		return g7_cert_a;
	}
#endif
	*len = stored.a_len;
	return stored.a;
}

const uint8_t *g7_certs_b(size_t *len)
{
#if HAVE_BUILTIN
	if (!stored.valid) {
		*len = sizeof(g7_cert_b);
		return g7_cert_b;
	}
#endif
	*len = stored.b_len;
	return stored.b;
}

const uint8_t *g7_certs_key(void)
{
#if HAVE_BUILTIN
	if (!stored.valid) {
		return g7_cert_key;
	}
#endif
	return stored.key;
}

/* ---- crypto ------------------------------------------------------------------- */

static void sha256(const uint8_t *data, size_t len, uint8_t digest[TC_SHA256_DIGEST_SIZE])
{
	struct tc_sha256_state_struct st;

	tc_sha256_init(&st);
	tc_sha256_update(&st, data, len);
	tc_sha256_final(digest, &st);
}

int g7_certs_sign(const uint8_t chal[16], uint8_t sig[64])
{
	uint8_t digest[TC_SHA256_DIGEST_SIZE];

	sha256(chal, 16, digest);
	return uECC_sign(g7_certs_key(), digest, sizeof(digest), sig, uECC_secp256r1()) ? 0 : -EIO;
}

/* The uncompressed public key (04 || X || Y) appears verbatim in certificate B. */
static bool key_matches_cert(const uint8_t key[KEY_LEN], const uint8_t *cert, size_t cert_len)
{
	uint8_t pub[65] = {0x04};

	if (!uECC_compute_public_key(key, pub + 1, uECC_secp256r1())) {
		return false;
	}
	for (size_t i = 0; i + sizeof(pub) <= cert_len; i++) {
		if (memcmp(cert + i, pub, sizeof(pub)) == 0) {
			return true;
		}
	}
	return false;
}

int g7_certs_selftest(void)
{
	size_t a_len, b_len;
	const uint8_t *b;
	uint8_t pub[64], chal[16], sig[64], digest[TC_SHA256_DIGEST_SIZE];

	if (g7_certs_source() == G7_CERTS_NONE) {
		LOG_ERR("No certificates loaded");
		return -ENOENT;
	}
	g7_certs_a(&a_len);
	b = g7_certs_b(&b_len);
	if (!key_matches_cert(g7_certs_key(), b, b_len)) {
		LOG_ERR("Signing key does not match certificate B");
		return -EFAULT;
	}

	sys_csrand_get(chal, sizeof(chal));
	int64_t t0 = k_uptime_get();

	if (g7_certs_sign(chal, sig)) {
		LOG_ERR("uECC_sign failed");
		return -EIO;
	}
	LOG_INF("Signed a test challenge in %lld ms", k_uptime_get() - t0);

	sha256(chal, sizeof(chal), digest);
	uECC_compute_public_key(g7_certs_key(), pub, uECC_secp256r1());
	if (!uECC_verify(pub, digest, sizeof(digest), sig, uECC_secp256r1())) {
		LOG_ERR("Signature does not verify");
		return -EFAULT;
	}
	LOG_INF("Certificates (%s): A %zu B, B %zu B, key matches, signature verifies",
		g7_certs_source() == G7_CERTS_STORED ? "stored" : "built in", a_len, b_len);
	return 0;
}

/* ---- upload ------------------------------------------------------------------- */

int g7_certs_stage(enum g7_cert_part part, size_t offset, const uint8_t *data, size_t len)
{
	uint8_t *buf;
	size_t max, *fill;

	switch (part) {
	case G7_CERT_PART_A:
		buf = staged.a, max = sizeof(staged.a), fill = &staged.a_len;
		break;
	case G7_CERT_PART_B:
		buf = staged.b, max = sizeof(staged.b), fill = &staged.b_len;
		break;
	case G7_CERT_PART_KEY:
		buf = staged.key, max = sizeof(staged.key), fill = &staged.key_len;
		break;
	default:
		return -EINVAL;
	}
	if (offset > max || len > max - offset) {
		return -ENOMEM;
	}

	k_mutex_lock(&lock, K_FOREVER);
	if (offset == 0) {
		*fill = 0;
	}
	if (offset != *fill) {
		/* Chunks must arrive in order. */
		k_mutex_unlock(&lock);
		return -EINVAL;
	}
	memcpy(buf + offset, data, len);
	*fill = offset + len;
	k_mutex_unlock(&lock);
	return 0;
}

/* keks_p3 is a PKCS#8 EC key; its ECPrivateKey holds `02 01 01 04 20 <32 bytes>`. */
static bool extract_scalar(const uint8_t *der, size_t len, uint8_t out[KEY_LEN])
{
	static const uint8_t marker[] = {0x02, 0x01, 0x01, 0x04, 0x20};

	if (len == KEY_LEN) {
		memcpy(out, der, KEY_LEN);
		return true;
	}
	for (size_t i = 0; i + sizeof(marker) + KEY_LEN <= len; i++) {
		if (memcmp(der + i, marker, sizeof(marker)) == 0) {
			memcpy(out, der + i + sizeof(marker), KEY_LEN);
			return true;
		}
	}
	return false;
}

int g7_certs_commit(void)
{
	uint8_t key[KEY_LEN];
	int err;

	k_mutex_lock(&lock, K_FOREVER);
	if (staged.a_len < CERT_MIN_LEN || staged.b_len < CERT_MIN_LEN ||
	    !extract_scalar(staged.key, staged.key_len, key)) {
		k_mutex_unlock(&lock);
		LOG_WRN("Certificate upload incomplete (A %zu, B %zu, key %zu bytes)",
			staged.a_len, staged.b_len, staged.key_len);
		return -EINVAL;
	}
	if (!key_matches_cert(key, staged.b, staged.b_len)) {
		k_mutex_unlock(&lock);
		LOG_WRN("Uploaded key does not match certificate B");
		return -EBADMSG;
	}

	err = settings_save_one("g7cert/a", staged.a, staged.a_len) ?:
	      settings_save_one("g7cert/b", staged.b, staged.b_len) ?:
	      settings_save_one("g7cert/k", key, KEY_LEN);
	if (!err) {
		memcpy(stored.a, staged.a, staged.a_len);
		memcpy(stored.b, staged.b, staged.b_len);
		memcpy(stored.key, key, KEY_LEN);
		stored.a_len = staged.a_len;
		stored.b_len = staged.b_len;
		stored.valid = true;
	}
	memset(&staged, 0, sizeof(staged));
	k_mutex_unlock(&lock);

	if (err) {
		LOG_ERR("Saving certificates failed (err %d)", err);
	} else {
		LOG_INF("Certificates saved (A %zu B, B %zu B)", stored.a_len, stored.b_len);
	}
	return err;
}

int g7_certs_clear(void)
{
	k_mutex_lock(&lock, K_FOREVER);
	memset(&stored, 0, sizeof(stored));
	memset(&staged, 0, sizeof(staged));
	k_mutex_unlock(&lock);

	int err = settings_delete("g7cert/a") ?: settings_delete("g7cert/b") ?:
		  settings_delete("g7cert/k");

	LOG_INF("Stored certificates removed");
	return err;
}
